#include <iarduino_ADC_CS1237.h>                                               // Подключаем библиотеку для работы АЦП на базе чипа CS1237.
iarduino_ADC_CS1237 adc(13,19);                                                // Объявляем объект для работы с функциями библиотеки iarduino_ADC_CS1237, указав выводы ( SCLK , DATA ). Можно указывать любые выводы Arduino.
                                                                               // Все функции бибилиотеки (кроме begin) являются не обязательными, если вам подходят значения по умолчанию.
void setup(){                                                                  //
     bool i;                                                                   //
     Serial.begin(9600);         while( !Serial );                             //
//   Настраиваем (конфигурируем) АЦП:                                          //
     i=adc.setPulseWidth(30);    if( !i ){ Serial.println("Ошибка width"  ); } // Указываем ширину импульсов на линии SCL. По умолчанию 5мкс. Увеличение требуется только для длинных линий. Функция вызывается до инициализации begin().
     i=adc.begin();              if( !i ){ Serial.println("Ошибка begin"  ); } // Инициируем работу с АЦП.
     i=adc.setPinVrefOut(true);  if( !i ){ Serial.println("Ошибка VrefOut"); } // Включаем вывод VrefOut. Возможные значения: true=вкл (по умолчанию), false=откл. На включённом выходе VrefOut появится сглаженное напряжение питания чипа (Vcc), которое можно подать на вход VrefIn.
     i=adc.setVrefIn(5.0);       if( !i ){ Serial.println("Ошибка VrefIn" ); } // Указываем опорное напряжение поданное на вход VrefIn. По умолчанию 5В. Вход VrefIn может получать либо внешнее напряжение от 1.5 до Vcc+0.1, либо напряжение питания чита (Vcc) с выхода VrefOut.
     i=adc.setSpeed(10);         if( !i ){ Serial.println("Ошибка speed"  ); } // Указываем скорость преобразований 10Гц. Возможные значения: 10, 40, 640, 1280 Гц. Это частота готовности новых данных для чтения. По умолчанию 10 Гц.
     i=adc.setPGA(1);            if( !i ){ Serial.println("Ошибка gain"   ); } // Указываем коэффициент усиления. Возможные значения: 1, 2, 64, 128. По умолчанию 128. Измеряемые напряжения лежат в диапазоне ±0.5 VrefIn / PGA.
     i=adc.setChannel(0);        if( !i ){ Serial.println("Ошибка channel"); } // Выбираем канал АЦП. Возможные значения: 0, 2, 3. 0-Канал А (по умолчанию), 1-Резерв, 2-Температура, 3-Внутреннее короткое замыкание.
//   Читаем настройки АЦП:                                                     //
     bool     pin   = adc.getPinVrefOut();                                     // Получаем состояние вывода VrefOut. Функция возвращает true-включён или false-отключён.
     uint16_t speed = adc.getSpeed();                                          // Получаем текущую скорость преобразований в Герцах. Функция возвращает частоту готовности новых данных: 10, 40, 640, или 1280 Гц.
     uint8_t  gain  = adc.getPGA();                                            // Получаем текущий коэффициент усиления. Функция возвращает значение: 1, 2, 64, или 128.
     uint8_t  chan  = adc.getChannel();                                        // Получаем используемый канал АЦП. Функция возвращает один из каналов: 0, 2, или 3.
     uint16_t width = adc.getPulseWidth();                                     // Получить ширину импульсов в мкс. Функция возвращает используемую библиотекой длительность импульсов и пауз на линии SCL в мкс.
     float    Vref  = adc.getVrefIn();                                         // Получить значение опорного напряжения VrefIn используемого библиотекой для рассчёта напряжения возвращаемого функцией getVoltage().
//   Выводим прочитанные настройки АЦП:                                        //
     Serial.println( (String) "Вывод VrefOut "+(pin?"вк":"отк")+"лючён."    ); //
     Serial.println( (String) "Скорость обновления данных "+speed+" Гц."    ); //
     Serial.println( (String) "Коэффициент усиления "+gain+"х."             ); //
     Serial.println( (String) "Используется "+chan+" канал АЦП."            ); //
     Serial.println( (String) "Ширина импульсов на линии SCL "+width+" мкс."); //
     Serial.println( (String) "Опорное напряжение VrefIn "+Vref+" В."       ); //
}                                                                              //
                                                                               //
void loop(){                                                                   //
//   Выводим на дисплей значения АЦП и напряжения:                             //
     int32_t i=adc.analogRead(); Serial.print("ADC="); Serial.print(i);        //   Читаем и выводим знаковое значение АЦП, от 0 до ±8388607.
     float   j=adc.getVoltage(); Serial.print(", V="); Serial.print(j,5);      //   Получаем и выводим напряжение на входе АЦП, от 0 до ±0,5 VrefIn. Vin = ADC*VrefIn/(2^24-1)/PGA.
     Serial.println("В."); delay(1000);                                        //
}                                                                              //